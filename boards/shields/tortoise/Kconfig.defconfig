## boards/shields/tortoise/Kconfig.defconfig
```kconfig
if SHIELD_TORTOISE_RIGHT

config ZMK_KEYBOARD_NAME
    default "tortoise"

config ZMK_SPLIT_ROLE_CENTRAL
    default y

endif



if SHIELD_TORTOISE_LEFT || SHIELD_TORTOISE_RIGHT

config INPUT
    default y

config ZMK_BLE
    default y

config ZMK_SPLIT
    default y
    
config NFCT_PINS_AS_GPIOS
    default y

config RGBLED_WIDGET_BATTERY_LEVEL_HIGH
    default 30

config RGBLED_WIDGET_BATTERY_LEVEL_CRITICAL
    default 10
    
endif
```

## boards/shields/tortoise/Kconfig.shield
```kconfig
config SHIELD_TORTOISE_LEFT
    def_bool $(shields_list_contains,tortoise_left)

config SHIELD_TORTOISE_RIGHT
    def_bool $(shields_list_contains,tortoise_right)
```

## config/west.yml
```yaml
manifest:
  remotes:
    - name: zmkfirmware
      url-base: https://github.com/zmkfirmware
    - name: badjeff   # <-- PMW3610
      url-base: https://github.com/badjeff
    - name: caksoylar # RGB LED
      url-base: https://github.com/caksoylar
  projects:
    - name: zmk
      remote: zmkfirmware
      revision: v0.3 #main
      import: app/west.yml
    - name: zmk-pmw3610-driver
      remote: badjeff
      revision: zmk-0.3 #main
    - name: zmk-rgbled-widget
      remote: caksoylar
      revision: v0.3
  self:
    path: config
# after zmk4.1
```
